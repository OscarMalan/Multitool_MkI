// Needed for SDA and SCL connections
#include <Wire.h>
#include <SPI.h>
// Oled panel functions
#include <Adafruit_GFX.h>
#include <Adafruit_SSD1306.h>
// Radio functions
#include <radio.h>
#include <TEA5767.h>
// Clock function
#include <DS3231.h>

DS3231 clock;
RTCDateTime dt;
String txt;

// Data to do with the screen
  #define SCREEN_WIDTH 128 // OLED display width,  in pixels
  #define SCREEN_HEIGHT 64 // OLED display height, in pixels
  Adafruit_SSD1306 oled(SCREEN_WIDTH, SCREEN_HEIGHT, &Wire, -1);

// Data to do with the radio
  #define FIX_BAND RADIO_BAND_FM // Makes the radio look for FM
  float FIX_STATION = 10000; // 100.00 MHz
  TEA5767 radio;

// The buttons, placement on the list, turning the radio on and if an option has been chosen
int Comp_Y = 0;
int Player_Y = 0;
int Ball_X = 64;
int Ball_Y = 32;
int Up_Button = 5;
int Down_Button = 4;
int Enter_Button = 8;
int Placement = 0;
int Radio_Power = 13;
int Score = 0;
bool Chosen = false;
bool Ball_Going_To_Player = true;
bool Ball_Going_Up = true;
bool Paddle_Contact = false;
int Held_Up = 0;
int Held_Down = 0;
char *Day[] = {"Monday", "Tuesday", "Wednesday", "Thursday", "Friday", "Saturday", "Sunday", "Error 03"};

void Ball_Move() {
  // Lose Condition
  if (Ball_X == 127) {oled.clearDisplay(); oled.setCursor(0, 10); oled.println("You Scored"); oled.println(Score); oled.display(); exit(0);}
  // Ball's X Axis rules
  else if (Ball_X == 10 && Ball_Y > 17+Comp_Y && Ball_Y < 47+Comp_Y){Ball_X++; Ball_Going_To_Player = true; Paddle_Contact = true;}
  else if (Ball_X == 117 && Ball_Y > 17+Player_Y && Ball_Y < 47+Player_Y){Score++; Ball_X--; Ball_Going_To_Player = false; Paddle_Contact = true;}
  else if (Ball_Going_To_Player == true){Ball_X++; Paddle_Contact = false;}
  else if (Ball_Going_To_Player == false){Ball_X--; Paddle_Contact = false;}
  // Ball's Y Axis rules
  if (Paddle_Contact == true){
    {if (random(0,100) >= 50){Ball_Going_Up = false; Ball_Y++;}else{Ball_Going_Up = true; Ball_Y--;}}
  }
  else if (Ball_Going_Up == true){if (Ball_Y == 1){Ball_Going_Up = false; Ball_Y++;} else{Ball_Y--;}}
  else if (Ball_Going_Up == false){if (Ball_Y == 63){Ball_Going_Up = true; Ball_Y--;} else{Ball_Y++;}}
}

// The Zorua Bitmap
const unsigned char Zorua [] PROGMEM = {
  0x00, 0x00, 0x00, 0x00, 0x00, 0x00, 0x00, 0x00, 0x00, 0x00, 0x00, 0x00, 0x00, 0x00, 0x00, 0x00, 
  0x00, 0x00, 0x00, 0x00, 0x00, 0x00, 0x00, 0x1e, 0x00, 0x00, 0x00, 0x00, 0x00, 0x00, 0x00, 0x00, 
  0x00, 0x00, 0x00, 0x00, 0x00, 0x00, 0x00, 0x61, 0x80, 0x00, 0x00, 0x00, 0x00, 0x00, 0x00, 0x00, 
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  0x00, 0x00, 0x00, 0x00, 0x00, 0x00, 0x00, 0x00, 0x00, 0x00, 0x00, 0x00, 0x00, 0x00, 0x00, 0x00
  };

// Option 1, which is an image
void Option1() {
  oled.clearDisplay();
  // Sets to display the bitmap
  oled.drawBitmap(0, 0, Zorua, 128, 64, WHITE);
  // Displays it on the screen
  oled.display();
  // Alt + F4 the program so that it
  // sticks on that screen, it can just be
  // manually reset
  exit(0);
}

// Option 2, which is a radio
void Option2() {
  digitalWrite(Radio_Power,HIGH);
  // Initialize the Radio 
  radio.init();

  oled.clearDisplay();
  oled.setCursor(0, 10);
  // HERE: adjust the frequency to a local sender
  radio.setBandFrequency(FIX_BAND, FIX_STATION);
  radio.setVolume(5);
  radio.setMono(false);
  if (digitalRead(Up_Button) == LOW)
    {if (FIX_STATION >= 10800) {FIX_STATION = 10800;}
    else {
    if (Held_Up == 10)
      {FIX_STATION += 300;} 
    else if (Held_Up >= 7)
      {FIX_STATION += 100; Held_Up++;}
    else 
      {FIX_STATION += 10; Held_Up++;}}}
  else if (digitalRead(Down_Button) == LOW) {
    if (FIX_STATION <= 7600) {FIX_STATION = 7600;}
    else {if (Held_Down == 10) {FIX_STATION -=300;}
    else if (Held_Down >= 7) {FIX_STATION -= 100; Held_Down++;}
    else {FIX_STATION -= 10; Held_Down++;}}}
  else{Held_Up = 0; Held_Down = 0;}
  oled.print(FIX_STATION/100);
  oled.println(" FM");
  oled.display();
}

// Option 3, which is a live clock
void Option3() {
  oled.setCursor(0, 10);
  oled.clearDisplay();
  dt = clock.getDateTime();
  oled.println(Day[dt.dayOfWeek - 1]);
  oled.print(dt.day);   oled.print("-");
  oled.print(dt.month);  oled.print("-");
  oled.print(dt.year);    oled.println(" ");
  oled.print(dt.hour);   oled.print(":");
  oled.print(dt.minute); oled.print(":");
  oled.print(dt.second); oled.println("");
  oled.display();
  delay(1000);
}

void Option4() {
    oled.clearDisplay();
  // Drawing the border
  oled.drawRect(1,1,127,63,WHITE);
  if (digitalRead(Up_Button) == LOW){
    if (Player_Y == -15){}
    else {Player_Y--;Serial.println(Player_Y);}}
  else if (digitalRead(Down_Button) == LOW){
    if (Player_Y == 14){}
    else {Player_Y++; Serial.println(Player_Y);}}
  // The computer choosing where to move
  if (Ball_Y <= 17 || Ball_Y >= 47){} else {Comp_Y = Ball_Y -31;}
  Serial.println(Ball_Y);
  // Computer Paddle
  oled.drawLine(10,17+Comp_Y,10,47+Comp_Y,WHITE);
  // Player Paddle
  oled.drawLine(117,17+Player_Y,117,47+Player_Y,WHITE);
  // The rules of the Ball moving
  Ball_Move();
  // The Ball
  oled.drawPixel(Ball_X, Ball_Y, WHITE);
  oled.display();
}

void setup() {
  // Establish communication
  Serial.begin(9600);

  clock.begin();
    // Set sketch compiling time, always comment after first time setting
    //the time, then commit a new copy of the code with this commented out
//      clock.setDateTime(__DATE__, __TIME__);

  //Define some data
  pinMode(Up_Button, INPUT_PULLUP);
  pinMode(Down_Button, INPUT_PULLUP);
  pinMode(Enter_Button, INPUT_PULLUP);
  pinMode(Radio_Power, OUTPUT);

  // initialize OLED display with address 0x3C for 128x64
  if (!oled.begin(SSD1306_SWITCHCAPVCC, 0x3C)) {
    Serial.println(F("SSD1306 allocation failed"));
    while (true);
  }

  // Help in the serial
  Serial.println("Error Codes:");
  Serial.println("01: Went to an invalid option on options screen.");
  Serial.println("02: Entered an invalid option, so don't know what to display.");
  Serial.println("03: Couldn't find what day it is.");

  // Starts the oled with a beginning text
  oled.clearDisplay();  
  oled.setTextSize(2);
  oled.setTextColor(WHITE);
  oled.setCursor(0, 10);
  oled.println("Begin");
  oled.display();
  delay(900);
}

void loop() {
  if (Chosen == false){
    // Setting up the display
    oled.clearDisplay();
    oled.setTextSize(2);
    oled.setTextColor(WHITE);
    oled.setCursor(0, 10);

    // Options
    if (Placement == 0) {oled.println("Friend");}
      else if (Placement == 1) {oled.println("Radio");}
      else if (Placement == 2) {oled.println("Clock");}
      else if (Placement == 3) {oled.println("Pong");}
      else {oled.println("Error 01");}
    oled.display();
    delay(200);
    if (digitalRead(Enter_Button) == LOW)
      {Chosen = true;}
    if (digitalRead(Up_Button) == LOW)
      {if (Placement == 0){}
      else {Placement--;}}
      else if (digitalRead(Down_Button) == LOW)
      {if (Placement == 3){}
      else {Placement++;}}
  }
  else if (Chosen == true){
    if (Placement == 0){Option1();}
    else if (Placement == 1){Option2();}
    else if (Placement == 2){Option3();}
    else if (Placement == 3){Option4();}
    else {oled.println("Error 02");}
    oled.display();
  }
}
